/* Copyright (c) 2017, The Linux Foundation. All rights reserved.
 * Copyright (C) 2019 XiaoMi, Inc.
 *
 * This program is free software; you can redistribute it and/or modify
 * it under the terms of the GNU General Public License version 2 and
 * only version 2 as published by the Free Software Foundation.
 *
 * This program is distributed in the hope that it will be useful,
 * but WITHOUT ANY WARRANTY; without even the implied warranty of
 * MERCHANTABILITY or FITNESS FOR A PARTICULAR PURPOSE.  See the
 * GNU General Public License for more details.
 */

&mdss_mdp {
	dsi_td4310_tianma_fhd_video: qcom,mdss_dsi_td4310_tianma_fhd_video {
		qcom,mdss-dsi-panel-name = "tianma td4310 fhd video mode dsi panel";
		qcom,mdss-dsi-panel-controller = <&mdss_dsi0>;
		qcom,mdss-dsi-panel-type = "dsi_video_mode";
		qcom,mdss-dsi-panel-framerate = <60>;
		qcom,mdss-dsi-virtual-channel-id = <0>;
		qcom,mdss-dsi-stream = <0>;
		qcom,mdss-dsi-panel-width = <1080>;
		qcom,mdss-dsi-panel-height = <2160>;
		qcom,mdss-pan-physical-width-dimension = <68>;
		qcom,mdss-pan-physical-height-dimension = <136>;
		qcom,mdss-dsi-h-front-porch = <108>;
		qcom,mdss-dsi-h-back-porch = <60>;
		qcom,mdss-dsi-h-pulse-width = <12>;
		qcom,mdss-dsi-h-sync-skew = <0>;
		qcom,mdss-dsi-v-back-porch = <33>;
		qcom,mdss-dsi-v-front-porch = <6>;
		qcom,mdss-dsi-v-pulse-width = <4>;
		qcom,mdss-dsi-h-left-border = <0>;
		qcom,mdss-dsi-h-right-border = <0>;
		qcom,mdss-dsi-v-top-border = <0>;
		qcom,mdss-dsi-v-bottom-border = <0>;
		qcom,mdss-dsi-bpp = <24>;
		qcom,mdss-dsi-underflow-color = <0xff>;
		qcom,mdss-dsi-border-color = <0>;
		qcom,mdss-dsi-h-sync-pulse = <0>;
		qcom,mdss-dsi-traffic-mode = "burst_mode";
		qcom,mdss-dsi-bllp-eof-power-mode;
		qcom,mdss-dsi-bllp-power-mode;
		qcom,mdss-dsi-lane-0-state;
		qcom,mdss-dsi-lane-1-state;
		qcom,mdss-dsi-lane-2-state;
		qcom,mdss-dsi-lane-3-state;
		qcom,mdss-dsi-panel-timings = [e6 38 26 00 68 6e 2a
				3c 44 03 04 00];
		qcom,mdss-dsi-t-clk-post = <0x0e>;
		qcom,mdss-dsi-t-clk-pre = <0x35>;
		qcom,mdss-dsi-bl-min-level = <1>;
		qcom,mdss-dsi-bl-max-level = <4095>;
		qcom,mdss-dsi-dma-trigger = "trigger_sw";
		qcom,mdss-dsi-mdp-trigger = "none";
		qcom,mdss-dsi-on-command = [
				39 01 00 00 46 00 02 11 00
				29 01 00 00 00 00 02 B0 04
				29 01 00 00 00 00 02 D6 01
				29 01 00 00 00 00 02 ea 0a

				39 01 00 00 00 00 02 51 ff
				39 01 00 00 00 00 02 53 2c
				29 01 00 00 00 00 1A CE 55 40 56 6E 87 95 a0 b0 c0 c2 c9 ce df e3 e4 ec FF 04 00 00 04 46 04 69 5A
				39 01 00 00 00 00 02 55 00
				39 01 00 00 00 00 02 35 00
				39 01 00 00 14 00 02 29 00
		];
		qcom,mdss-dsi-off-command = [
				05 01 00 00 14 00 02 28 00
				05 01 00 00 78 00 02 10 00
		];
		qcom,mdss-dsi-ce-on-command = [
		];
		qcom,mdss-dsi-ce-off-command = [
		];
		qcom,mdss-dsi-srgb-on-command = [
				15 01 00 00 00 00 02 FF 22
				15 00 00 00 00 00 02 FB 01
				15 00 00 00 00 00 02 00 35
				15 00 00 00 00 00 02 01 35
				15 00 00 00 00 00 02 02 35
				15 00 00 00 00 00 02 03 35
				15 00 00 00 00 00 02 04 34
				15 00 00 00 00 00 02 05 34
				15 00 00 00 00 00 02 06 34
				15 00 00 00 00 00 02 07 34
				15 00 00 00 00 00 02 08 33
				15 00 00 00 00 00 02 09 33
				15 00 00 00 00 00 02 0A 33
				15 00 00 00 00 00 02 0B 33
				15 00 00 00 00 00 02 0C 33
				15 00 00 00 00 00 02 0D 33
				15 00 00 00 00 00 02 0E 33
				15 00 00 00 00 00 02 0F 33
				15 00 00 00 00 00 02 10 32
				15 00 00 00 00 00 02 11 50
				15 00 00 00 00 00 02 12 60
				15 00 00 00 00 00 02 13 70
				15 00 00 00 00 00 02 14 58
				15 00 00 00 00 00 02 15 68
				15 01 00 00 00 00 02 16 78
				15 00 00 00 00 00 02 17 77
				15 00 00 00 00 00 02 18 40
				15 00 00 00 00 00 02 19 40
				15 00 00 00 00 00 02 1A 40
				15 00 00 00 00 00 02 1B 40
				15 00 00 00 00 00 02 1C 40
				15 00 00 00 00 00 02 1D 40
				15 00 00 00 00 00 02 1E 40
				15 00 00 00 00 00 02 1F 40
				15 00 00 00 00 00 02 20 40
				15 00 00 00 00 00 02 21 45
				15 00 00 00 00 00 02 22 49
				15 00 00 00 00 00 02 23 4C
				15 00 00 00 00 00 02 24 4B
				15 00 00 00 00 00 02 25 48
				15 00 00 00 00 00 02 26 44
				15 00 00 00 00 00 02 27 41
				15 00 00 00 00 00 02 28 40
				15 01 00 00 00 00 02 2D 00
				15 00 00 00 00 00 02 2F 37
				15 00 00 00 00 00 02 30 36
				15 00 00 00 00 00 02 31 36
				15 00 00 00 00 00 02 32 36
				15 00 00 00 00 00 02 33 38
				15 00 00 00 00 00 02 34 38
				15 00 00 00 00 00 02 35 36
				15 00 00 00 00 00 02 36 37
				15 00 00 00 00 00 02 37 36
				15 00 00 00 00 00 02 38 37
				15 00 00 00 00 00 02 39 34
				15 00 00 00 00 00 02 3A 34
				15 00 00 00 00 00 02 3B 32
				15 00 00 00 00 00 02 3D 32
				15 00 00 00 00 00 02 3F 30
				15 00 00 00 00 00 02 40 2F
				15 00 00 00 00 00 02 41 2C
				15 00 00 00 00 00 02 42 36
				15 00 00 00 00 00 02 43 36
				15 00 00 00 00 00 02 44 36
				15 00 00 00 00 00 02 45 36
				15 00 00 00 00 00 02 46 35
				15 01 00 00 00 00 02 47 35
				15 00 00 00 00 00 02 48 35
				15 00 00 00 00 00 02 49 35
				15 00 00 00 00 00 02 4A 35
				15 00 00 00 00 00 02 4B 35
				15 00 00 00 00 00 02 4C 35
				15 00 00 00 00 00 02 4D 34
				15 00 00 00 00 00 02 4E 33
				15 00 00 00 00 00 02 4F 33
				15 00 00 00 00 00 02 50 32
				15 00 00 00 00 00 02 51 31
				15 00 00 00 00 00 02 52 30
				15 00 00 00 00 00 02 53 01
				15 00 00 00 00 00 02 54 00
				15 00 00 00 00 00 02 55 FE
				15 00 00 00 00 00 02 56 77
				15 00 00 00 00 00 02 58 41
				15 00 00 00 00 00 02 59 42
				15 00 00 00 00 00 02 5A 43
				15 01 00 00 00 00 02 5B 44
				15 00 00 00 00 00 02 5C 44
				15 00 00 00 00 00 02 5D 45
				15 00 00 00 00 00 02 5E 45
				15 00 00 00 00 00 02 5F 44
				15 00 00 00 00 00 02 60 C3
				15 00 00 00 00 00 02 61 44
				15 00 00 00 00 00 02 62 46
				15 00 00 00 00 00 02 63 47
				15 00 00 00 00 00 02 64 47
				15 00 00 00 00 00 02 65 48
				15 00 00 00 00 00 02 66 4A
				15 00 00 00 00 00 02 67 4C
				15 00 00 00 00 00 02 68 50
				15 00 00 00 00 00 02 69 4D
				15 00 00 00 00 00 02 6A 49
				15 00 00 00 00 00 02 6B 47
				15 00 00 00 00 00 02 6C 47
				15 01 00 00 00 00 02 6D 47
				15 00 00 00 00 00 02 6E 45
				15 00 00 00 00 00 02 6F 44
				15 00 00 00 00 00 02 70 00
				15 00 00 00 00 00 02 71 00
				15 00 00 00 00 00 02 72 01
				15 00 00 00 00 00 02 73 00
				15 00 00 00 00 00 02 74 06
				15 00 00 00 00 00 02 75 0C
				15 00 00 00 00 00 02 76 03
				15 00 00 00 00 00 02 77 09
				15 00 00 00 00 00 02 78 0F
				15 00 00 00 00 00 02 79 68
				15 00 00 00 00 00 02 7A 88
				15 00 00 00 00 00 02 7C 80
				15 00 00 00 00 00 02 7D 80
				15 00 00 00 00 00 02 7E 80
				15 00 00 00 00 00 02 7F 80
				15 01 00 00 00 00 02 80 06
				15 00 00 00 00 00 02 81 00
				15 00 00 00 00 00 02 83 01
				15 00 00 00 00 00 02 84 04
				15 00 00 00 00 00 02 85 5D
				15 00 00 00 00 00 02 86 59
				15 00 00 00 00 00 02 87 63
				15 00 00 00 00 00 02 88 40
				15 00 00 00 00 00 02 89 80
				15 00 00 00 00 00 02 8A 80
				15 00 00 00 00 00 02 8B 80
				15 00 00 00 00 00 02 8C 80
				15 00 00 00 00 00 02 8D 80
				15 00 00 00 00 00 02 8E 80
				15 00 00 00 00 00 02 8F 80
				15 00 00 00 00 00 02 90 80
				15 00 00 00 00 00 02 91 80
				15 00 00 00 00 00 02 92 80
				15 01 00 00 00 00 02 93 80
				15 00 00 00 00 00 02 94 80
				15 00 00 00 00 00 02 95 80
				15 00 00 00 00 00 02 96 80
				15 00 00 00 00 00 02 97 80
				15 00 00 00 00 00 02 98 80
				15 00 00 00 00 00 02 99 80
				15 00 00 00 00 00 02 9A 80
				15 00 00 00 00 00 02 9B 80
				15 00 00 00 00 00 02 9C 80
				15 00 00 00 00 00 02 9D 80
				15 00 00 00 00 00 02 9E 80
				15 00 00 00 00 00 02 9F 80
				15 00 00 00 00 00 02 A0 80
				15 00 00 00 00 00 02 A2 7C
				15 00 00 00 00 00 02 A6 80
				15 00 00 00 00 00 02 A7 80
				15 00 00 00 00 00 02 A9 80
				15 01 00 00 00 00 02 AA 80
				15 00 00 00 00 00 02 AB 80
				15 00 00 00 00 00 02 AC 80
				15 00 00 00 00 00 02 AD 80
				15 00 00 00 00 00 02 AE 80
				15 00 00 00 00 00 02 AF 6F
				15 00 00 00 00 00 02 B7 76
				15 00 00 00 00 00 02 B8 76
				15 00 00 00 00 00 02 B9 05
				15 00 00 00 00 00 02 BA 0D
				15 00 00 00 00 00 02 BB 14
				15 00 00 00 00 00 02 BC 0F
				15 00 00 00 00 00 02 BD 18
				15 00 00 00 00 00 02 BE 1F
				15 00 00 00 00 00 02 BF 05
				15 00 00 00 00 00 02 C0 0D
				15 00 00 00 00 00 02 C1 14
				15 00 00 00 00 00 02 C2 03
				15 00 00 00 00 00 02 C3 07
				15 00 00 00 00 00 02 C4 0A
				15 01 00 00 00 00 02 C5 A0
				15 00 00 00 00 00 02 C6 55
				15 00 00 00 00 00 02 C7 FF
				15 00 00 00 00 00 02 C8 39
				15 00 00 00 00 00 02 C9 44
				15 00 00 00 00 00 02 CA 12
				15 00 00 00 00 00 02 CD 80
				15 00 00 00 00 00 02 DB 70
				15 00 00 00 00 00 02 DC 80
				15 00 00 00 00 00 02 DD 80
				15 00 00 00 00 00 02 E0 7A
				15 00 00 00 00 00 02 E1 7F
				15 00 00 00 00 00 02 E2 80
				15 00 00 00 00 00 02 E3 80
				15 00 00 00 00 00 02 E4 80
				15 00 00 00 00 00 02 E5 40
				15 00 00 00 00 00 02 E6 40
				15 00 00 00 00 00 02 E7 40
				15 01 00 00 00 00 02 E8 40
				15 00 00 00 00 00 02 E9 40
				15 00 00 00 00 00 02 EA 40
				15 00 00 00 00 00 02 EB 40
				15 00 00 00 00 00 02 EC 40
				15 00 00 00 00 00 02 ED 40
				15 00 00 00 00 00 02 EE 40
				15 00 00 00 00 00 02 EF 40
				15 00 00 00 00 00 02 F0 40
				15 00 00 00 00 00 02 F1 40
				15 00 00 00 00 00 02 F2 40
				15 00 00 00 00 00 02 F3 40
				15 00 00 00 00 00 02 F4 40
				15 00 00 00 00 00 02 F5 40
				15 00 00 00 00 00 02 F6 40
				15 01 00 00 00 00 02 FF 10
				15 01 00 00 00 00 02 55 80
		];
		qcom,mdss-dsi-srgb-off-command = [
				15 01 00 00 00 00 02 FF 10
				15 01 00 00 00 00 02 55 00
		];
		qcom,mdss-dsi-cabc-on-command = [
				15 00 00 00 00 00 02 55 01
				29 00 00 00 00 00 08 B8 89 51 0d 00 02 00 00
				29 00 00 00 00 00 1A CE 55 40 4d 6a 75 97 a7 b6 c9 d0 d4 e7 e8 e9 f2 fb ff 04 00 00 04 46 04 69 5a
				29 01 00 00 00 00 0A F9 64 FF E0 BE 00 8D BF 80 00
		];
		qcom,mdss-dsi-cabc-off-command = [
				15 01 00 00 00 00 02 55 00
		];
		qcom,mdss-dsi-gamma0-command = [
				29 01 00 00 00 00 14 C8 01 00 04 01 fe fc 00 00 03 ff fe fc 00 00 04 fb f8 fc 00
		];
		qcom,mdss-dsi-gamma1-command = [
				29 01 00 00 00 00 14 C8 01 00 01 FD 01 CC 00 00 02 FE 01 FC 00 00 01 FF FF B7 00
		];
		qcom,mdss-dsi-gamma2-command = [
				29 01 00 00 00 00 14 C8 01 00 01 FE 01 F3 00 00 02 FE 01 FC 00 00 01 FE FE E0 00
		];
		qcom,mdss-dsi-gamma3-command = [
				29 01 00 00 00 00 14 C8 03 00 01 FD 01 FE 00 00 02 FE FF F0 00 00 01 FE FD FE 00
		];
		qcom,mdss-dsi-gamma4-command = [
				29 01 00 00 00 00 14 C8 01 00 01 FD 01 FC 00 00 02 FE 01 B6 00 00 01 FE FD FC 00
		];
		qcom,mdss-dsi-gamma5-command = [
				29 01 00 00 00 00 14 C8 01 00 01 FD 01 FC 00 00 02 FE FF D9 00 00 01 FF 01 CB 00
		];
		qcom,mdss-dsi-gamma6-command = [
				29 01 00 00 00 00 14 C8 01 00 01 FD 01 FC 00 00 02 FE FF D9 00 00 01 FF 01 CB 00
		];
		qcom,mdss-dsi-gamma7-command = [
				29 01 00 00 00 00 14 C8 01 00 01 FD 01 CC 00 00 02 FE 01 FC 00 00 01 FE FD FC 00
		];
		qcom,mdss-dsi-gamma8-command = [
				29 01 00 00 00 00 14 C8 01 00 01 FD 01 84 00 00 02 FE 01 FC 00 00 01 FE FD FC 00
		];
		qcom,mdss-dsi-gamma9-command = [
				29 01 00 00 00 00 14 C8 01 00 01 FD 01 FC 00 00 02 FE FE E7 00 00 01 FE 01 8F 00
		];
		qcom,mdss-dsi-gamma10-command = [
				29 01 00 00 00 00 14 C8 01 00 01 FD 01 FC 00 00 02 FE 01 FC 00 00 01 FF 01 CB 00
		];
		qcom,mdss-dsi-gamma11-command = [
				29 01 00 00 00 00 14 C8 01 00 01 FD 01 FC 00 00 02 FF 01 AE 00 00 01 FF 01 CB 00
		];
		qcom,mdss-dsi-gamma12-command = [
				29 01 00 00 00 00 14 C8 01 00 01 FD 01 FC 00 00 02 FF 01 AE 00 00 01 FF 01 CB 00
		];
		qcom,mdss-dsi-gamma13-command = [
				29 01 00 00 00 00 14 C8 01 00 01 FD 01 FC 00 00 02 FE 01 FC 00 00 01 FF FF B8 00
		];
		qcom,mdss-dsi-gamma14-command = [
				29 01 00 00 00 00 14 C8 01 00 01 FD 01 FC 00 00 02 FE 01 FC 00 00 01 FF 01 CB 00
		];
		qcom,mdss-dsi-gamma15-command = [
				29 01 00 00 00 00 14 C8 01 00 01 FD 01 FC 00 00 02 FF 01 AE 00 00 01 FF 01 CB 00
		];
		qcom,mdss-dsi-gamma16-command = [
				29 01 00 00 00 00 14 C8 01 00 01 FD 01 FC 00 00 02 FF 01 AE 00 00 01 FF 01 CB 00
		];
		qcom,mdss-dsi-gamma17-command = [
				29 01 00 00 00 00 14 C8 01 00 01 FE 01 85 00 00 02 FE 01 FC 00 00 01 FF 01 B6 00
		];
		qcom,mdss-dsi-gamma18-command = [
				29 01 00 00 00 00 14 C8 01 00 01 FE 01 AB 00 00 02 FE 01 FC 00 00 01 FE FE DD 00
		];
		qcom,mdss-dsi-gamma19-command = [
				29 01 00 00 00 00 14 C8 01 00 01 FD 01 CE 00 00 02 FE FE E3 00 00 01 FE FD FC 00
		];
		qcom,mdss-dsi-gamma20-command = [
				29 01 00 00 00 00 14 C8 01 00 01 FD 01 CE 00 00 02 FE FE E3 00 00 01 FE FD FC 00
		];
		qcom,mdss-dsi-gamma21-command = [
				29 01 00 00 00 00 14 C8 01 00 01 FE 01 3D 00 00 02 FE 01 FC 00 00 01 FF FF B5 00
		];
		qcom,mdss-dsi-gamma22-command = [
				29 01 00 00 00 00 14 C8 01 00 01 FE FF 63 00 00 02 FE 01 FC 00 00 01 FE 01 DA 00
		];
		qcom,mdss-dsi-gamma23-command = [
				29 01 00 00 00 00 14 C8 01 00 01 FE 01 86 00 00 02 FE 01 E6 00 00 01 FE FD FC 00
		];
		qcom,mdss-dsi-gamma24-command = [
				29 01 00 00 00 00 14 C8 01 00 01 FE 01 86 00 00 02 FE 01 E6 00 00 01 FE FD FC 00
		];


		qcom,mdss-dsi-on-command-state = "dsi_lp_mode";
		qcom,mdss-dsi-off-command-state = "dsi_hs_mode";
		qcom,mdss-dsi-ce-on-command-state = "dsi_lp_mode";
		qcom,mdss-dsi-ce-off-command-state = "dsi_lp_mode";
		qcom,mdss-dsi-srgb-on-command-state = "dsi_lp_mode";
		qcom,mdss-dsi-srgb-off-command-state = "dsi_lp_mode";
		qcom,mdss-dsi-cabc-on-command-state = "dsi_hs_mode";
		qcom,mdss-dsi-cabc-off-command-state = "dsi_lp_mode";
		qcom,mdss-dsi-gamma-command-state = "dsi_lp_mode";
		qcom,mdss-dsi-bl-pmic-control-type = "bl_ctrl_wled";
		qcom,mdss-dsi-reset-sequence = <1 1>, <0 5>, <1 35>;
		qcom,mdss-dsi-tx-eot-append;
		qcom,mdss-dsi-post-init-delay = <1>;

		qcom,mdss-dsi-panel-status-command = [06 01 00 01 05 00 01 0A];
		qcom,mdss-dsi-panel-status-command-state = "dsi_hs_mode";
		qcom,mdss-dsi-panel-status-check-mode = "reg_read";
		qcom,mdss-dsi-panel-status-read-length = <1>;
		qcom,mdss-dsi-panel-status-value = <0x1c>;
		qcom,mdss-dsi-panel-max-error-count = <3>;
		qcom,mdss-dsi-panel-hdr-enabled;
		qcom,mdss-dsi-panel-hdr-color-primaries = <14500 15500 32000
			17000 15500 30000 8000 3000>;
		qcom,mdss-dsi-panel-peak-brightness = <4300000>;
		qcom,mdss-dsi-panel-blackness-level = <3230>;

		cm,mdss-livedisplay-cabc-ui-cmd = [
				15 00 00 00 00 00 02 55 01
				29 00 00 00 00 00 08 B8 89 51 0d 00 02 00 00
				29 00 00 00 00 00 1A CE 55 40 4d 6a 75 97 a7 b6 c9 d0 d4 e7 e8 e9 f2 fb ff 04 00 00 04 46 04 69 5a
				29 01 00 00 00 00 0A F9 64 FF E0 BE 00 8D BF 80 00
		];
		cm,mdss-livedisplay-cabc-cmd = [
				15 01 00 00 00 00 02 55 00
		];
	};
};
